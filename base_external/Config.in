## base_external/Config.in
```kconfig
config BR2_MY_PROJECT
	bool "project_base"




if BR2_MY_PROJECT
	menu "project base"
		source "$BR2_EXTERNAL_project_base_PATH/package/aesd-assignments/Config.in" 
	endmenu
endif
```
